## src/examples/px4_hello_world_app/Kconfig
```kconfig
menuconfig EXAMPLES_PX4_HELLO_WORLD_APP
	bool "px4_hello_world_app"
	default n
	---help---
		Enable support for px4_hello_world_app
```

## src/modules/mad_max/Kconfig
```kconfig
menuconfig MODULES_MAD_MAX
	bool "mad_max"
	default y
	---help---
		Enable mad_max module, a module used for the workshop
```

## src/modules/sensor_handler/Kconfig
```kconfig
menuconfig MODULES_SENSOR_HANDLER
	bool "sensor_handler_module"
	default n
	---help---
		Enable support for sensor_handler
```
